


.equ TEST,2
.equ ANSICODE,3







#ansicode - see keyboardtest.s
	# A - code to call


.equ CLEARSCREEN,		1
.equ CLEARENDOFSCREEN,	2
.equ CLEARBEGINOFSCREEN,3
.equ CLEARWHOLESCREEN,	4
.equ CLEARCURRENTLINE,	5
.equ CLEARTOENDOFLINE,	6
.equ CLEARFROMSTARTOFLINE,7
.equ CLEARLINE,			8
.equ COLORRESET,		9
.equ COLORBOLD,			10
.equ COLORDIM,			11
.equ COLORFGBLACK,		12
.equ COLORFGRED,		13
.equ COLORFGGREEN,		14
.equ COLORFGYELLOW,		15
.equ COLORFGBLUE,		16
.equ COLORFGMAGENTA,	17
.equ COLORFGCYAN,		18
.equ COLORFGWHITE,		19
.equ COLORBGBLACK,		20
.equ COLORBGRED,		21
.equ COLORBGGREEN,		22
.equ COLORBGYELLOW,		23
.equ COLORBGBLUE,		24
.equ COLORBGMAGENTA,	25
.equ COLORBGCYAN,		26
.equ COLORBGWHITE,		27

